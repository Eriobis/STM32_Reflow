/**********************************************************************************************************************
 * @file    max31855.c
 * @author  Simon Benoit
 * @date    06-12-2017
 * @brief
 *********************************************************************************************************************/

/* Includes ---------------------------------------------------------------------------------------------------------*/

#include "stm32l0xx_hal.h"
#include "main.h"
#include <math.h>

/* Local Defines ----------------------------------------------------------------------------------------------------*/

/* Local Typedefs ---------------------------------------------------------------------------------------------------*/

/* Forward Declarations ---------------------------------------------------------------------------------------------*/

static int16_t MAX31855_readFirst16bits(void);
static int16_t MAX31855_readSecond16bits(void);

/* Local Constants --------------------------------------------------------------------------------------------------*/

/* Local Variables --------------------------------------------------------------------------------------------------*/

extern SPI_HandleTypeDef hspi1;

/* Local Functions --------------------------------------------------------------------------------------------------*/

/**
  *--------------------------------------------------------------------------------------------------------------------
  * @brief
  *
  * @param  none
  *
  * @retval none
  *
  *--------------------------------------------------------------------------------------------------------------------
  */
static int16_t MAX31855_readFirst16bits(void)
{
    HAL_StatusTypeDef status;
    uint8_t data[4];
 
    HAL_GPIO_WritePin(MAX31855_CS_Port, MAX31855_CS_Pin, GPIO_PIN_RESET);
    HAL_Delay(1);
    status = HAL_SPI_Receive(&hspi1, data, 4, 100);
    HAL_GPIO_WritePin(MAX31855_CS_Port, MAX31855_CS_Pin, GPIO_PIN_SET);
    return (data[0] << 8 | data[1]);
}

/**
  *--------------------------------------------------------------------------------------------------------------------
  * @brief
  *
  * @param  none
  *
  * @retval none
  *
  *--------------------------------------------------------------------------------------------------------------------
  */
static int16_t MAX31855_readSecond16bits(void)
{
    HAL_StatusTypeDef status;
    uint8_t data[4];
    
    HAL_GPIO_WritePin(MAX31855_CS_Port, MAX31855_CS_Pin, GPIO_PIN_RESET);
    HAL_Delay(1);
    status = HAL_SPI_Receive(&hspi1, data, 4, 100);
    HAL_GPIO_WritePin(MAX31855_CS_Port, MAX31855_CS_Pin, GPIO_PIN_SET);
    return (data[2] << 8 | data[3]);
}

/* Global Functions -------------------------------------------------------------------------------------------------*/

/**
  *--------------------------------------------------------------------------------------------------------------------
  * @brief
  *
  * @param  none
  *
  * @retval none
  *
  *--------------------------------------------------------------------------------------------------------------------
  */
float MAX31855_readCelsius(void)
{
    int16_t v = MAX31855_readFirst16bits();
    float tmp;

    // First bit is fault
    if (v && !(v & 0x1))
    {
        if (v & 0x8000)
        {
            tmp =  (float)(((~v) & 0xfffc) + 0x4) / -16.0;
        }
        else
        {
            tmp = (float)(v & 0xfffc) / 16.0;
        }
        return tmp;
    }
    return NAN;
}

/**
  *--------------------------------------------------------------------------------------------------------------------
  * @brief
  *
  * @param  none
  *
  * @retval none
  *
  *--------------------------------------------------------------------------------------------------------------------
  */
float MAX31855_readCJCelsius(void)
{
    int16_t v = MAX31855_readSecond16bits();
    if (v & 0x8000)
        return (((~v) & 0xfff0) + 0x10) / -256.0;
    else
        return (float)(v & 0xfff0) / 256.0;
}

/**
  *--------------------------------------------------------------------------------------------------------------------
  * @brief
  *
  * @param  none
  *
  * @retval none
  *
  *--------------------------------------------------------------------------------------------------------------------
  */
char MAX31855_readStatus(void)
{
    int16_t v = MAX31855_readSecond16bits();
    return v & 0x7;
}
